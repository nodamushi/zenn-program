## src/spresense/camera/src/cam/Kconfig
```kconfig
config WORK_CAM
	tristate "cam app"
	default y
	depends on HAVE_CXX
	---help---
		Enable the cam app

if WORK_CAM

config WORK_CAM_PROGNAME
	string "Program name"
	default "cam"
	---help---
		This is the name of the program that will be use when the NSH ELF
		program is installed.

config WORK_CAM_PRIORITY
	int "cam task priority"
	default 100

config WORK_CAM_STACKSIZE
	int "cam stack size"
	default 2048

endif
```

## src/spresense/camera/src/video/Kconfig
```kconfig
config WORK_VIDEO
	tristate "video app"
	default y
	---help---
		Enable the video app

if WORK_VIDEO

config WORK_VIDEO_PROGNAME
	string "Program name"
	default "video"
	---help---
		This is the name of the program that will be use when the NSH ELF
		program is installed.

config WORK_VIDEO_PRIORITY
	int "video task priority"
	default 100

config WORK_VIDEO_STACKSIZE
	int "video stack size"
	default 2048

endif
```

## src/spresense/hello/src/my_hello/Kconfig
```kconfig
config WORK_MY_HELLO
	tristate "my_hello app"
	default y
	---help---
		Enable the my_hello app

if WORK_MY_HELLO

config WORK_MY_HELLO_PROGNAME
	string "Program name"
	default "my_hello"
	---help---
		This is the name of the program that will be use when the NSH ELF
		program is installed.

config WORK_MY_HELLO_PRIORITY
	int "my_hello task priority"
	default 100

config WORK_MY_HELLO_STACKSIZE
	int "my_hello stack size"
	default 2048

endif
```

## src/spresense/message/src/msg/Kconfig
```kconfig
config WORK_MSG
	tristate "msg app"
	default y
	---help---
		Enable the msg app

if WORK_MSG

config WORK_MSG_PROGNAME
	string "Program name"
	default "msg"
	---help---
		This is the name of the program that will be use when the NSH ELF
		program is installed.

config WORK_MSG_PRIORITY
	int "msg task priority"
	default 100

config WORK_MSG_STACKSIZE
	int "msg stack size"
	default 2048

endif
```

## src/spresense/multi_thread/src/thd/Kconfig
```kconfig
config WORK_THD
	tristate "thd app"
	default y
	---help---
		Enable the thd app

if WORK_THD

config WORK_THD_PROGNAME
	string "Program name"
	default "thd"
	---help---
		This is the name of the program that will be use when the NSH ELF
		program is installed.

config WORK_THD_PRIORITY
	int "thd task priority"
	default 100

config WORK_THD_STACKSIZE
	int "thd stack size"
	default 2048

endif
```
